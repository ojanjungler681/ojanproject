#include <WiFi.h>
#include <HTTPClient.h>
#include <ArduinoJson.h>
#include <time.h>
#include <Adafruit_ST7735.h>
#include <SPI.h>
// WiFi credentials
const char* ssid = "WAHDANIAH"; //wifi ssid
const char* password = "AllahuAkbar"; //password
const char* jsonURL = "https://raw.githubusercontent.com/ojanjungler681/databaseojan/main/db.json"; //raw link github, to acces database
const char* googleScriptURL = "https://script.google.com/macros/s/AKfycbxC660ueLzrnVpim8vtjxti9YLUMpN4Of70CIKYfcpLIfwOBj8jaDQkDIRYJl6TX52ogQ/exec"; //google script url (send data to google spreadhseet)
// Time configuration (UTC+8)
const char* ntpServer = "pool.ntp.org";
const long gmtOffset_sec = 28800; // 8*60*60
const int daylightOffset_sec = 0;
// Hardware
HardwareSerial BarcodeSerial(2); // UART2 for GM65
String lastMaterialCode = "";
unsigned long lastScanTime = 0;
const unsigned long debounceTime = 500;
// TFT Display
#define TFT_CS     5
#define TFT_RST    21
#define TFT_DC     22
#define TFT_BL     19  // Backlight control
Adafruit_ST7735 tft = Adafruit_ST7735(TFT_CS, TFT_DC, TFT_RST);
// Icons
static const unsigned char PROGMEM image_clock_bits[] = {0x07,0xc0,0x18,0x30,0x29,0x28,0x41,0x04,0x61,0x0c,0x81,0x02,0x81,0x02,0xe1,0x0e,0x80,0x82,0x80,0x42,0x60,0x2c,0x40,0x04,0x29,0x28,0x19,0x30,0x07,0xc0,0x00,0x00};
static const unsigned char PROGMEM image_wifi_full_bits[] = {0x01,0xf0,0x00,0x07,0xfc,0x00,0x1e,0x0f,0x00,0x39,0xf3,0x80,0x77,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0x00,0x00};
static const unsigned char PROGMEM image_download_bits[] = {0x21,0xf0,0x00,0x16,0x0c,0x00,0x08,0x03,0x00,0x25,0xf0,0x80,0x42,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0x00,0x00};
static const unsigned char PROGMEM image_file_search_bits[] = {0x01,0xf0,0x02,0x08,0x04,0x04,0x08,0x02,0x08,0x02,0x08,0x0a,0x08,0x0a,0x08,0x12,0x04,0x64,0x0a,0x08,0x15,0xf0,0x28,0x00,0x50,0x00,0xa0,0x00,0xc0,0x00,0x00,0x00};
static const unsigned char PROGMEM image_checked_bits[] = {0x00,0x00,0x00,0x00,0x00,0x00,0x00,0x04,0x00,0x0c,0x00,0x1c,0x80,0x38,0xc0,0x70,0xe0,0xe0,0x71,0xc0,0x3b,0x80,0x1f,0x00,0x0e,0x00,0x04,0x00,0x00,0x00,0x00,0x00};
static const unsigned char PROGMEM image_Error_bits[] = {0x03,0xf0,0x00,0x0f,0xfc,0x00,0x1f,0xfe,0x00,0x3f,0xff,0x00,0x73,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0xf0,0x00};
static const unsigned char PROGMEM image_RFIDDolphinSend_bits[] = {0x00,0x00,0x7f,0xf8,0x00,0x00,0x00,0x02,0x00,0x00,0x00,0x00,0x00,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0x00,0x00};
static const unsigned char PROGMEM image_DolphinDone_bits[] = {0x00,0x00,0x00,0x00,0x00,0xff,0xf8,0x00,0x00,0x00,0x00,0x00,0x00,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0x00,0x6b};
void showInitializingScreen() {
  tft.fillScreen(ST77XX_BLACK);
  tft.setTextColor(0xFFFF);
  tft.setCursor(21, 6);
  tft.print("BARCODE SCANNER");  
  tft.setCursor(29, 19);
  tft.print("INITIALIZING");
  tft.setTextColor(0x73AE);
  tft.setCursor(10, 44);
  tft.print("CONNECTING TO WIFI");  
  tft.setTextColor(0x73AE);
  tft.setCursor(34, 91);
  tft.print("SYNC TIME");
  tft.drawBitmap(50, 56, image_wifi_full_bits, 19, 16, 0x55E);
  tft.drawBitmap(52, 102, image_clock_bits, 15, 16, 0x24BE);
}
void showWifiConnectedScreen() {
  tft.fillScreen(ST77XX_BLACK);
  tft.setTextColor(0xFFFF);
  tft.setCursor(21, 6);
  tft.print("BARCODE SCANNER");

  tft.setTextColor(0x4B1);
  tft.setCursor(13, 51);
  tft.print("CONNECTED TO WIFI");

  tft.setTextColor(0x5FA);
  tft.setCursor(13, 105);
  tft.print("READY FOR SCANNING");

  tft.drawBitmap(52, 71, image_wifi_full_bits, 19, 15, 0x3A96);
}

void ShowSuccesScreen() {
  tft.fillScreen(ST77XX_BLACK);
  tft.setTextColor(0xFFFF);
  tft.setCursor(21, 6);
  tft.print("BARCODE SCANNER");

  tft.setTextColor(0x5FA);
  tft.setCursor(45, 25);
  tft.print("SUCCESS");
  tft.drawBitmap(23, 66, image_DolphinDone_bits, 80, 58, 0xF206);
}

void showWifiFailedScreen() {
  tft.fillScreen(ST77XX_BLACK);
  tft.setTextColor(0xFFFF);
  tft.setCursor(21, 6);
  tft.print("BARCODE SCANNER");

  tft.setTextColor(0xE8EC);
  tft.setCursor(4, 59);
  tft.print("FAIL CONNECT TO WIFI");
  tft.drawBitmap(52, 71, image_download_bits, 19, 16, 0xF206);
}

void showScanningScreen() {
  tft.fillScreen(ST77XX_BLACK);
  tft.setTextColor(0xFFFF);
  tft.setCursor(21, 6);
  tft.print("BARCODE SCANNER");

  tft.setTextColor(0xE8EC);
  tft.setCursor(38, 71);
  tft.print("SCANNING");
  tft.drawBitmap(53, 86, image_file_search_bits, 15, 16, 0xFFFF);
}

void showBarcodeFoundScreen(const String& code) {
  tft.fillScreen(ST77XX_BLACK);
  tft.setTextColor(0xFFFF);
  tft.setCursor(21, 6);
  tft.print("BARCODE SCANNER");

  tft.setTextColor(0x4B1);
  tft.setCursor(23, 20);
  tft.print("SERIAL NUMBER");
  
  tft.setTextColor(0x4B1);
  tft.setCursor(41, 31);
  tft.print("BARCODE");

  // Center the barcode text
  int16_t x = (128 - code.length() * 6) / 2;
  tft.setTextColor(0x4B1);
  tft.setCursor(x, 60);
  tft.print(code);

  tft.setTextColor(0xFFFF);
  tft.setCursor(14, 97);
  tft.print("EXPLORING DATABASE");
  tft.drawBitmap(56, 108, image_file_search_bits, 15, 16, 0x4B1);
}

void showDataSentScreen() {
  tft.fillScreen(ST77XX_BLACK);
  tft.setTextColor(0xFFFF);
  tft.setCursor(21, 6);
  tft.print("BARCODE SCANNER");

  tft.setTextColor(0xBDF7);
  tft.setCursor(38, 25);
  tft.print("SEND TO");

  tft.setTextColor(0x4B1);
  tft.setCursor(10, 38);
  tft.print("GOOGLE SPREADSHEET");
  tft.drawBitmap(15, 58, image_RFIDDolphinSend_bits, 97, 61, 0xF206);
}

void showInvalidBarcodeScreen() {
  tft.fillScreen(ST77XX_BLACK);
  tft.setTextColor(0xFFFF);
  tft.setCursor(21, 6);
  tft.print("BARCODE SCANNER");

  tft.setTextColor(0xE8EC);
  tft.setCursor(21, 49);
  tft.print("INVALID BARCODE");

  tft.setTextColor(0xFFFF);
  tft.setCursor(24, 99);
  tft.print("PLEASE RE SCAN");
  tft.drawBitmap(54, 62, image_Error_bits, 18, 18, 0xE8EC);
}

void showValidBarcodeScreen(){
 tft.fillScreen(ST77XX_BLACK);
  tft.setTextColor(0xFFFF);
  tft.setCursor(21, 6);
  tft.print("BARCODE SCANNER");
  tft.setTextColor(0xBDF7);
  tft.setCursor(38, 25);
  tft.print("SEND TO");
  tft.setTextColor(0x4B1);
  tft.setCursor(10, 38);
  tft.print("GOOGLE SPREADSHEET");
  tft.drawBitmap(15, 58, image_RFIDDolphinSend_bits, 97, 61, 0xF206);
}

void showReadyScreen() {
  tft.fillScreen(ST77XX_BLACK);
  tft.setTextColor(0xFFFF);
  tft.setCursor(21, 6);
  tft.print("BARCODE SCANNER");

  tft.setTextColor(0x5FA);
  tft.setCursor(31, 77);
  tft.print("READY TO SCAN");
}

String urlEncode(const String& str) {
  String encoded;
  for (unsigned int i = 0; i < str.length(); i++) {
    char c = str[i];
    if (isalnum(c) || c == '-' || c == '_' || c == '.' || c == '~') {
      encoded += c;
    } else if (c == ' ') {
      encoded += '+';
    } else if (c == ':') {
      encoded += "%3A";
    } else {
      char hex[4];
      sprintf(hex, "%%%02X", (unsigned char)c);
      encoded += hex;
    }
  }
  return encoded;
}

void sendToGoogleSheets(const char* date, const char* time, const String& code, const String& desc, const String& category) {
  HTTPClient http;
  http.begin(googleScriptURL);
  http.setFollowRedirects(HTTPC_STRICT_FOLLOW_REDIRECTS);
  http.addHeader("Content-Type", "application/x-www-form-urlencoded");
  
  String postData = "date=" + urlEncode(date) + 
                    "&time=" + urlEncode(time) + 
                    "&code=" + urlEncode(code) + 
                    "&desc=" + urlEncode(desc) + 
                    "&cat=" + urlEncode(category);
  
  int httpResponseCode = http.POST(postData);
  http.end();
  
  if (httpResponseCode > 0) {
    showDataSentScreen(); // First show "sent to spreadsheet" screen
    delay(2000);
    ShowSuccesScreen();  // Then show success confirmation
  } else {
    showInvalidBarcodeScreen(); // Only show invalid if sending fails
  }
  delay(3000);
  showReadyScreen();
}

void setup() {
  // Initialize TFT display
  tft.initR(INITR_144GREENTAB);  
  tft.setRotation(1);            
  tft.fillScreen(ST77XX_BLACK); 
  tft.setTextColor(0xFFFF);      
  tft.setTextSize(1);            
  
  showInitializingScreen();
  
  // Initialize serial for barcode scanner
  BarcodeSerial.begin(9600, SERIAL_8N1, 16, 17);
  
  // Connect to WiFi
  WiFi.begin(ssid, password);
  int retry = 0;
  while (WiFi.status() != WL_CONNECTED && retry < 20) {
    delay(500);
    retry++;
  }
  
  if (WiFi.status() == WL_CONNECTED) {
    showWifiConnectedScreen();
  } else {
    showWifiFailedScreen();
    while(1) delay(1000); // Stop if WiFi fails
  }
  
  // Initialize time
  configTime(gmtOffset_sec, daylightOffset_sec, ntpServer);
  while (!time(nullptr)) {
    delay(500);
  }
  
  showReadyScreen();
}

void loop() {
  if (BarcodeSerial.available()) {
    String scannedCode = BarcodeSerial.readStringUntil('\n');
    scannedCode.trim();
    
    if (millis() - lastScanTime < debounceTime) return;
    lastScanTime = millis();
    
    if (scannedCode == lastMaterialCode) return;
    lastMaterialCode = scannedCode;
    
    showScanningScreen();
    delay(500);
    showBarcodeFoundScreen(scannedCode);
    
    if (WiFi.status() != WL_CONNECTED) {
      WiFi.reconnect();
      delay(2000);
      if (WiFi.status() != WL_CONNECTED) {
        showWifiFailedScreen();
        delay(3000);
        showReadyScreen();
        return;
      }
    }
    
    // Get current date and time
    struct tm timeinfo;
    if(!getLocalTime(&timeinfo)) {
      showInvalidBarcodeScreen();
      delay(3000);
      showReadyScreen();
      return;
    }
    
    char dateStr[11]; // YYYY-MM-DD
    strftime(dateStr, sizeof(dateStr), "%Y-%m-%d", &timeinfo);
    char timeStr[9]; // HH:MM:SS
    strftime(timeStr, sizeof(timeStr), "%H:%M:%S", &timeinfo);
    
    // Fetch material data
    HTTPClient http;
    http.begin(jsonURL);
    http.setTimeout(10000);
    int httpCode = http.GET();
    
    if (httpCode != HTTP_CODE_OK) {
      http.end();
      showInvalidBarcodeScreen();
      delay(3000);
      showReadyScreen();
      return;
    }
    
    String payload = http.getString();
    http.end();
    
    DynamicJsonDocument doc(2048);
    DeserializationError error = deserializeJson(doc, payload);
    
    if (error) {
      showInvalidBarcodeScreen();
      delay(3000);
      showReadyScreen();
      return;
    }
    
    bool found = false;
    String materialDesc, category;
    
    // First check if barcode exists in database
    for (JsonObject item : doc.as<JsonArray>()) {
      const char* materialCode = item["code material"];
      if (materialCode && scannedCode.equals(materialCode)) {
        found = true;
        materialDesc = item["material description"] | "No description";
        category = item["kategori"] | "N/A";
        break;
      }
    }
    
    if (!found) {
      showInvalidBarcodeScreen();
      delay(3000);
      showReadyScreen();
      return;
    }
    
    // If valid, show validation screen first
    showValidBarcodeScreen();
    delay(3000);
    
    // Then proceed to send to Google Sheets
    sendToGoogleSheets(dateStr, timeStr, scannedCode, materialDesc, category);
    return;
  }
}
